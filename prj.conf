## Kconfig
```
#
# Copyright (c) 2023 Nordic Semiconductor
#
# SPDX-License-Identifier: LicenseRef-Nordic-5-Clause
#

config USE_SLIMENRF_CONSOLE
    bool "Use basic console"
    default y
    help
        Use basic console for commands.

config BATTERY_CHARGER_HAS_NTC
    bool "Battery thermistor"
    help
      Flag for battery NTC thermistor availability.

choice
    prompt "Battery voltage mapping"
    default BATTERY_NO_MAPPING

config BATTERY_USE_REG_BUCK_MAPPING
    bool "Use buck regulator mapping (3.7V battery, DCDC)"
    help
      Use a constant power mapping for battery voltage.
      Preffered for systems with a buck regulator.
      Measured at a system voltage of 3.0V.

config BATTERY_USE_REG_LDO_MAPPING
    bool "Use LDO linear regulator mapping (3.7V battery, LDO)"
    help
      Use a constant current mapping for battery voltage.
      Preferred for systems with a linear regulator.

config BATTERY_NO_MAPPING
    bool "Disable battery voltage mapping"
    help
      Always map to 100% battery. Disables battery monitoring.

endchoice

config BATTERY_LOW_RUNTIME_THRESHOLD
    int "Low battery runtime threshold (ms)"
    default 10800000
    help
      Trigger low battery when estimated runtime falls below threshold.
      If estimated runtime is not available, low battery will trigger under 10% estimated state of charge.

choice
    prompt "Status LED color mapping"
    default LED_TRI_COLOR

config LED_RGB_COLOR
    bool "Use RGB color mapping"
    help
        Use RGB or RG color mapping for LED status if available.

config LED_TRI_COLOR
    bool "Use default color mapping"
    help
        Use the default color mapping for LED status.

endchoice

menu "Status LED default status color"
    depends on LED_RGB_COLOR

config LED_DEFAULT_COLOR_R
    int "Red value"
    range 0 10000
    default 4000
    depends on LED_RGB_COLOR
    help
        Red color for default status.
        Valid range is 0 to 10000.

config LED_DEFAULT_COLOR_G
    int "Green value"
    range 0 10000
    default 6000
    depends on LED_RGB_COLOR
    help
        Green color for default status.
        Valid range is 0 to 10000.

config LED_DEFAULT_COLOR_B
    int "Blue value"
    range 0 10000
    default 0
    depends on LED_RGB_COLOR
    help
        Blue color for default status.
        Valid range is 0 to 10000.

endmenu

config USER_EXTRA_ACTIONS
    bool "Multiple press actions"
    help
        Allow user to use multiple presses to calibrate, pair, or enter DFU.
        By default, pairing is available when holding down sw0 for 5 seconds.
        By default, DFU is available when holding down sw0 and plugging in a USB cable.

config IGNORE_RESET
    bool "Ignore reset"
    default y
    help
        If sw0 is available, don't perform any extra actions on reset.

config USER_SHUTDOWN
    bool "User shutdown support"
    default y
    help
        Allow user to use reset or sw0 to shutdown.

config USE_IMU_WAKE_UP
    bool "IMU wake up support"
    default y
    help
        Use IMU wake up state if IMU wake up is present.

config DELAY_SLEEP_ON_STATUS
    bool "Delay IMU wake up mode on status flags"
    default y
    depends on USE_IMU_WAKE_UP
    help
        Delay IMU wake up state if there is an active status flag or in pairing mode.

config WOM_USE_DCDC
    bool "Use DCDC in IMU wake up mode"
    depends on USE_IMU_WAKE_UP
    help
        Use DCDC instead of LDO in IMU wake up state if it is more efficient.

config CONNECTION_TIMEOUT_DELAY
    int "Connection timeout delay (ms)"
    default 300000
    depends on USER_SHUTDOWN
    help
        Connection timeout duration when receiver is not detected.

menu "Sensor power saving"

config SENSOR_LP_TIMEOUT
    int "Sensor low power delay (ms)"
    default 600000
    help
        Low power timeout during no motion. RFT default 10 min — keeps the
        sensor in LOW_NOISE (167 Hz loop) so quick snap motions don't get
        absorbed by a sleeping FIFO. The intermediate LOW_POWER state is
        rarely useful for active tracking; we go LOW_NOISE → WOM
        (also 10 min) directly.

config SENSOR_USE_LOW_POWER_2
    bool "Use additional low power modes"
    help
        Use a higher latency sensor mode during no motion.

config USE_IMU_TIMEOUT
    bool "Use IMU wake up state"
    default y
    depends on USE_IMU_WAKE_UP
    help
        Use IMU wake up state during no motion.

config IMU_TIMEOUT_RAMP_MIN
    int "Sensor timeout minimum delay (ms)"
    default 5000
    depends on USE_IMU_TIMEOUT || SENSOR_USE_LOW_POWER_2
    help
        Minimum timeout during no motion. Initial period on wake up.

config IMU_TIMEOUT_RAMP_MAX
    int "Sensor timeout maximum delay (ms)"
    default 15000
    depends on USE_IMU_TIMEOUT || SENSOR_USE_LOW_POWER_2
    help
        Maximum timeout during no motion.

config USE_ACTIVE_TIMEOUT
    bool "Use activity timeout"
    default y
    depends on USE_IMU_WAKE_UP || USER_SHUTDOWN
    help
        Delay IMU wake up state or user shutdown during activity.

choice
    prompt "Activity timeout mode"
    default SLEEP_ON_ACTIVE_TIMEOUT
    depends on USE_ACTIVE_TIMEOUT

config SLEEP_ON_ACTIVE_TIMEOUT
    bool "IMU wake up"
    depends on USE_IMU_WAKE_UP
    help
        Use IMU wake up state when activity timeout elapses.

config SHUTDOWN_ON_ACTIVE_TIMEOUT
    bool "User shutdown"
    depends on USER_SHUTDOWN
    help
        Use user shutdown when activity timeout elapses.

endchoice

config ACTIVE_TIMEOUT_THRESHOLD
    int "Activity timeout threshold (ms)"
    default 15000
    depends on USE_ACTIVE_TIMEOUT
    help
        Trigger activity timeout after a certain threshold of activity.

config ACTIVE_TIMEOUT_DELAY
    int "Activity timeout delay (ms)"
    default 900000
    depends on USE_ACTIVE_TIMEOUT
    help
        Activity timeout duration when triggered.

endmenu

config SENSOR_ACCEL_ODR
    int "Accelerometer output data rate (Hz)"
    default 100
    help
        Requested accelerometer output data rate. Actual rate will be raised to the nearest supported rate.
        A higher rate will increase the time to read and process sensor data.

config SENSOR_GYRO_ODR
    int "Gyrometer output data rate (Hz)"
    default 200
    help
        Requested gyrometer output data rate. Actual rate will be raised to the nearest supported rate.
        A higher rate will increase the time to read and process sensor data.
        A lower rate is recommended for IMUs with poor gyrometer rate noise density. (e.g. BMI270, LSM6DS3TR-C)

config SENSOR_ACCEL_FS
    int "Accelerometer full scale (g)"
    default 16
    help
        Requested accelerometer full scale. Actual scale will be raised to the nearest supported scale.
        RFT default 16g — bike use sees high jolt events; quantization is fine for VQF gravity tracking.
        A lower scale may improve noise performance, but is more likely to saturate.

config SENSOR_GYRO_FS
    int "Gyrometer full scale (dps)"
    default 4000
    help
        Requested gyrometer full scale. Actual scale will be raised to the nearest supported scale.
        RFT default 4000dps — wrist snaps can exceed 2000dps, saturation causes orientation flips.
        A lower scale may improve noise performance, but is more likely to saturate.

config SENSOR_USE_MAG
    bool "Magnetometer support"
    default y
    help
        Use magnetometer if it is present.

config USE_SENSOR_CLOCK
    bool "Use external IMU clock"
    default y
    help
        Use external IMU clock if it is present.

choice
    prompt "Sensor fusion"
    default SENSOR_USE_VQF
    help
        Select the sensor fusion method.

config SENSOR_USE_XIOFUSION
    bool "Use x-io Technologies Fusion"
    help
        Use x-io Technologies Fusion for sensor fusion.
        Based on Madgwick filter.

config SENSOR_USE_VQF
    bool "Use VQF"
    help
        Use VQF for sensor fusion.
        Based on Kalman filter.

endchoice

config SENSOR_USE_6_SIDE_CALIBRATION
    bool "Use 6-side calibration"
    default y
    depends on USE_SLIMENRF_CONSOLE
    help
        Use 6-side calibration for accelerometer.
        Calibration can be completed through the basic console.

config RADIO_TX_POWER
    int "Radio output power (dBm)"
    default 8
    help
        Radio output power level.
        A lower value may reduce power consumption.

config CONNECTION_OVER_HID
    bool "Use HID for data output"
    help
        Use HID if available.
        Otherwise, use ESB only.

source "Kconfig.zephyr"
```

## sysbuild.conf
```
# Sysbuild config for RFT v1.1 build
# Enable MCUboot bootloader for USB CDC serial recovery DFU
SB_CONFIG_BOOTLOADER_MCUBOOT=y
```

## prj.conf
```kconfig
#CONFIG_NCS_SAMPLES_DEFAULTS
CONFIG_ASSERT=y
CONFIG_ASSERT_NO_COND_INFO=y
CONFIG_ASSERT_NO_MSG_INFO=y
CONFIG_RESET_ON_FATAL_ERROR=y

CONFIG_NCS_APPLICATION_BOOT_BANNER_STRING="SlimeVR-Tracker-nRF"
#CONFIG_NCS_BOOT_BANNER=n
CONFIG_BOOT_BANNER=n

CONFIG_ESB=y
# RFT: tracker chains pkt4→pkt8→pkt9 within one mag tick (~3 packets in
# rapid succession when streaming). Default FIFO depth drops them.
CONFIG_ESB_TX_FIFO_SIZE=4

# RFT: trackers must keep streaming for the duration of a track session
# (battery-bound, not motion-bound). The upstream defaults shut down
# after a few minutes of no motion or activity, which is wrong for
# on-bike use (the rider can be stationary at a red light or grid).
# Disable both no-motion and activity timeouts entirely; the only
# automatic shutdown left is the receiver-loss timeout.
CONFIG_USE_IMU_TIMEOUT=n
CONFIG_USE_ACTIVE_TIMEOUT=n
#need to enable for nRF54L
#CONFIG_NRFX_DPPI10=y

CONFIG_ADC=y
CONFIG_ADC_NRFX_SAADC=y
CONFIG_FPU=y
CONFIG_I2C=y
CONFIG_SPI=y
CONFIG_PINCTRL=y
CONFIG_SENSOR=y

CONFIG_NVS=y
CONFIG_NVS_LOOKUP_CACHE=y
CONFIG_NVS_INIT_BAD_MEMORY_REGION=y

CONFIG_POWEROFF=y
CONFIG_REBOOT=y

CONFIG_FLASH=y
CONFIG_FLASH_PAGE_LAYOUT=y
CONFIG_FLASH_MAP=y

CONFIG_SETTINGS=y
CONFIG_SETTINGS_RUNTIME=y
CONFIG_SETTINGS_NONE=y

CONFIG_MPU_ALLOW_FLASH_WRITE=y

CONFIG_RETAINED_MEM=y

CONFIG_USE_SEGGER_RTT=y
CONFIG_LOG=y
#CONFIG_PRINTK=y
CONFIG_LOG_MODE_DEFERRED=y
CONFIG_LOG_SPEED=y
CONFIG_LOG_BACKEND_RTT=y
CONFIG_CBPRINTF_FP_SUPPORT=y
CONFIG_ADC_LOG_LEVEL_OFF=y
CONFIG_LOG_FUNC_NAME_PREFIX_ERR=y
CONFIG_LOG_BUFFER_SIZE=1536
CONFIG_LOG_BACKEND_UART_AUTOSTART=n
CONFIG_LOG_PROCESS_THREAD_SLEEP_MS=50
CONFIG_LOG_PROCESS_THREAD_STACK_SIZE=1024

CONFIG_PWM=y
CONFIG_GPIO=y

CONFIG_CRC=y

CONFIG_NEWLIB_LIBC=y
#deprecated?
#CONFIG_NRFX_TIMER1=y

#speed up boot? (use internal rc oscillator)
CONFIG_CLOCK_CONTROL_NRF_K32SRC_RC=y
CONFIG_CLOCK_CONTROL_NRF_K32SRC_RC_CALIBRATION=n
#speed up boot? (synthesize lf clock)
#CONFIG_CLOCK_CONTROL_NRF_K32SRC_SYNTH=y

# dont need it
CONFIG_CRYPTO=n

# set timeout for 25ms, sufficient for ~1000 bytes
CONFIG_I2C_NRFX_TRANSFER_TIMEOUT=25

CONFIG_USB_DEVICE_HID=y
CONFIG_USB_DEVICE_VID=0x1209
CONFIG_USB_DEVICE_PID=0x7692
CONFIG_USB_HID_BOOT_PROTOCOL=y
CONFIG_USB_DEVICE_INITIALIZE_AT_BOOT=n
CONFIG_USB_CDC_ACM=y
CONFIG_UART_INTERRUPT_DRIVEN=y
CONFIG_USB_WORKQUEUE_STACK_SIZE=512

CONFIG_SERIAL=y
CONFIG_CONSOLE=y
CONFIG_RTT_CONSOLE=y
CONFIG_UART_CONSOLE=y
CONFIG_UART_LINE_CTRL=y
# fit "write all <base64:173>"
CONFIG_CONSOLE_INPUT_MAX_LINE_LEN=256

CONFIG_LOG=y
CONFIG_USB_DRIVER_LOG_LEVEL_ERR=y
CONFIG_USB_DEVICE_LOG_LEVEL_ERR=y
CONFIG_USB_CDC_ACM_LOG_LEVEL_OFF=y

CONFIG_LOG_BACKEND_UART=y

CONFIG_CONSOLE_SUBSYS=y
CONFIG_CONSOLE_GETLINE=y

CONFIG_NVS_LOG_LEVEL_WRN=y
CONFIG_USB_HID_LOG_LEVEL_WRN=y

CONFIG_USB_DEVICE_SOF=y
CONFIG_USB_HID_REPORTS=256

#CONFIG_USB_HID_POLL_INTERVAL_MS=1
CONFIG_USB_HID_POLL_INTERVAL_MS=0
CONFIG_HID_INTERRUPT_EP_MPS=64
#CONFIG_ENABLE_HID_INT_OUT_EP=y

CONFIG_SYSTEM_WORKQUEUE_STACK_SIZE=256
CONFIG_MAIN_STACK_SIZE=512
#crashing on nrf54l at 512

CONFIG_THREAD_NAME=y

# TODO: because of icm426, this will break things and needs to be raised to at least 3k
CONFIG_HEAP_MEM_POOL_SIZE=2048
CONFIG_ISR_STACK_SIZE=1024

CONFIG_PM_DEVICE=y

CONFIG_BASE64=y

#CONFIG_THREAD_ANALYZER=y
#CONFIG_THREAD_ANALYZER_AUTO=y
#CONFIG_THREAD_ANALYZER_AUTO_INTERVAL=5
```

## src/config.c
```c
#include "globals.h"
#include "system/system.h"

#include "config.h"

#if DT_NODE_HAS_STATUS_OKAY(DT_ALIAS(retainedmemdevice))
#define MEMORY_REGION DT_PARENT(DT_ALIAS(retainedmemdevice))
#else
#error "retained_mem region not defined"
#endif

#define RETAINED_SETTINGS_OFFSET offsetof(struct retained_data, settings)

struct config_settings_data *config_settings = (struct config_settings_data *)(DT_REG_ADDR(MEMORY_REGION) + RETAINED_SETTINGS_OFFSET);

const uint16_t config_settings_count[] = {
	CONFIG_0_SETTINGS_END,
	CONFIG_1_SETTINGS_END,
	CONFIG_2_SETTINGS_END,
	CONFIG_3_SETTINGS_END
};

const char *config_settings_names[] = {
	"user_extra_actions", // 0
	"ignore_reset",
	"user_shutdown",
	"use_imu_wake_up",
	"delay_sleep_on_status",
	"connection_over_hid",
	"sensor_use_low_power_2", // 1
	"use_imu_timeout",
	"use_active_timeout",
	"sensor_use_mag",
	"use_sensor_clock",
	"sensor_use_6_side_calibration",
	"led_default_color_r", // 2
	"led_default_color_g",
	"led_default_color_b",
	"active_timeout_mode",
	"sensor_accel_odr",
	"sensor_gyro_odr",
	"sensor_accel_fs",
	"sensor_gyro_fs",
	"sensor_fusion",
	"radio_tx_power",
	"connection_timeout_delay", // 3
	"sensor_lp_timeout",
	"imu_timeout_ramp_min",
	"imu_timeout_ramp_max",
	"active_timeout_threshold",
	"active_timeout_delay",
	"battery_low_runtime_threshold"
};

const bool config_0_settings_defaults[16] = {
	IS_ENABLED(CONFIG_USER_EXTRA_ACTIONS),
	IS_ENABLED(CONFIG_IGNORE_RESET),
	IS_ENABLED(CONFIG_USER_SHUTDOWN),
	IS_ENABLED(CONFIG_USE_IMU_WAKE_UP),
	IS_ENABLED(CONFIG_DELAY_SLEEP_ON_STATUS),
	IS_ENABLED(CONFIG_CONNECTION_OVER_HID),
};

const bool config_1_settings_defaults[16] = {
	IS_ENABLED(CONFIG_SENSOR_USE_LOW_POWER_2),
	IS_ENABLED(CONFIG_USE_IMU_TIMEOUT),
	IS_ENABLED(CONFIG_USE_ACTIVE_TIMEOUT),
	IS_ENABLED(CONFIG_SENSOR_USE_MAG),
	IS_ENABLED(CONFIG_USE_SENSOR_CLOCK),
	IS_ENABLED(CONFIG_SENSOR_USE_6_SIDE_CALIBRATION),
};

const int16_t config_2_settings_defaults[16] = {
#ifdef CONFIG_LED_DEFAULT_COLOR_R
	CONFIG_LED_DEFAULT_COLOR_R, // 0-10000
#else
	4000,
#endif
#ifdef CONFIG_LED_DEFAULT_COLOR_G
	CONFIG_LED_DEFAULT_COLOR_G, // 0-10000
#else
	6000,
#endif
#ifdef CONFIG_LED_DEFAULT_COLOR_B
	CONFIG_LED_DEFAULT_COLOR_B, // 0-10000
#else
	0,
#endif
#if CONFIG_SHUTDOWN_ON_ACTIVE_TIMEOUT
	1,
#else // CONFIG_SLEEP_ON_ACTIVE_TIMEOUT
	0,
#endif
	CONFIG_SENSOR_ACCEL_ODR, // 0-3200 (e.g.)
	CONFIG_SENSOR_GYRO_ODR, // 0-3200 (e.g.)
	CONFIG_SENSOR_ACCEL_FS, // 0-32000 (e.g.)
	CONFIG_SENSOR_GYRO_FS, // 0-32000 (e.g.)
#if CONFIG_SENSOR_USE_VQF
	3,
#elif CONFIG_SENSOR_USE_NXPSENSORFUSION
	2,
#elif CONFIG_SENSOR_USE_XIOFUSION
	1,
#else
	0,
#endif
	CONFIG_RADIO_TX_POWER, // -128-127
};

const int32_t config_3_settings_defaults[16] = {
#ifdef CONFIG_CONNECTION_TIMEOUT_DELAY
	CONFIG_CONNECTION_TIMEOUT_DELAY,
#else
	300000,
#endif
	CONFIG_SENSOR_LP_TIMEOUT,
#ifdef CONFIG_IMU_TIMEOUT_RAMP_MIN
	CONFIG_IMU_TIMEOUT_RAMP_MIN,
#else
	600000, // RFT: 10 min (was 5s) — bike usage doesn't sit still long enough for fast WOM
#endif
#ifdef CONFIG_IMU_TIMEOUT_RAMP_MAX
	CONFIG_IMU_TIMEOUT_RAMP_MAX,
#else
	600000, // RFT: 10 min (was 15s)
#endif
#ifdef CONFIG_ACTIVE_TIMEOUT_THRESHOLD
	CONFIG_ACTIVE_TIMEOUT_THRESHOLD,
#else
	15000,
#endif
#ifdef CONFIG_ACTIVE_TIMEOUT_DELAY
	CONFIG_ACTIVE_TIMEOUT_DELAY,
#else
	900000,
#endif
	CONFIG_BATTERY_LOW_RUNTIME_THRESHOLD,
};

LOG_MODULE_REGISTER(config, LOG_LEVEL_INF);

void config_settings_init(void)
{
	/* RFT: ignore per-bit ovrd flags and unconditionally apply Kconfig
	 * defaults at every boot. The upstream behavior — protecting any value
	 * a user once wrote against later default changes — is the reason an
	 * already-fixed `=n` flag in prj.conf still didn't disable auto-sleep
	 * on trackers that had once been flipped ON via console. We want a bike
	 * tracker whose behavior is fully source-defined: rebuild + reflash is
	 * the only source of truth. Console writes still work for live debug
	 * but won't survive a reboot. */
	for (int i = 0; i < 16; i++)
	{
		uint16_t write_mask = 1 << i;
		if (config_0_settings_defaults[i])
			config_settings->config_0_settings |= write_mask;
		else
			config_settings->config_0_settings &= ~write_mask;
		if (config_1_settings_defaults[i])
			config_settings->config_1_settings |= write_mask;
		else
			config_settings->config_1_settings &= ~write_mask;
		config_settings->config_2_settings[i] = config_2_settings_defaults[i];
		config_settings->config_3_settings[i] = config_3_settings_defaults[i];
	}
	/* Clear ovrd too — keeps the retained-mem bitmap clean and avoids
	 * surprising state if this branch is ever reverted. */
	config_settings->config_0_ovrd = 0;
	config_settings->config_1_ovrd = 0;
	config_settings->config_2_ovrd = 0;
	config_settings->config_3_ovrd = 0;
}

void config_0_settings_write(uint16_t id, bool value)
{
	uint16_t write_mask = 1 << id;

	config_settings->config_0_ovrd |= write_mask;

	if (value)
		config_settings->config_0_settings |= write_mask;
	else
		config_settings->config_0_settings &= ~write_mask;

	sys_write(SETTINGS_ID, NULL, retained->settings, sizeof(retained->settings));
}

void config_1_settings_write(uint16_t id, bool value)
{
	uint16_t write_mask = 1 << id;

	config_settings->config_1_ovrd |= write_mask;

	if (value)
		config_settings->config_1_settings |= write_mask;
	else
		config_settings->config_1_settings &= ~write_mask;

	sys_write(SETTINGS_ID, NULL, retained->settings, sizeof(retained->settings));
}

void config_2_settings_write(uint16_t id, int16_t value)
{
	uint16_t write_mask = 1 << id;

	config_settings->config_2_ovrd |= write_mask;

	config_settings->config_2_settings[id] = value;

	sys_write(SETTINGS_ID, NULL, retained->settings, sizeof(retained->settings));
}

void config_3_settings_write(uint16_t id, int32_t value)
{
	uint16_t write_mask = 1 << id;

	config_settings->config_3_ovrd |= write_mask;

	config_settings->config_3_settings[id] = value;

	sys_write(SETTINGS_ID, NULL, retained->settings, sizeof(retained->settings));
}

void config_settings_reset(uint16_t config, uint16_t id)
{
	uint16_t write_mask = 1 << id;

	switch (config)
	{
	case 0:
		config_settings->config_0_ovrd &= ~write_mask;
		break;
	case 1:
		config_settings->config_1_ovrd &= ~write_mask;
		break;
	case 2:
		config_settings->config_2_ovrd &= ~write_mask;
		break;
	case 3:
		config_settings->config_3_ovrd &= ~write_mask;
		break;
	default:
	}

	config_settings_init(); // reset non-overridden value

	sys_write(SETTINGS_ID, NULL, retained->settings, sizeof(retained->settings));
}

void config_settings_reset_all(void)
{
	static bool reset_confirm = false;
	if (!reset_confirm)
	{
		printk("Resetting device settings will clear all user-defined settings to the firmware defaults. Please resend the command to confirm.\n");
		reset_confirm = true;
		return;
	}
	printk("Resetting device settings\n");

	config_settings->config_0_ovrd = 0;
	config_settings->config_1_ovrd = 0;
	config_settings->config_2_ovrd = 0;
	config_settings->config_3_ovrd = 0;

	config_settings_init(); // reset non-overridden value

	sys_write(SETTINGS_ID, NULL, retained->settings, sizeof(retained->settings));
	reset_confirm = false;
	LOG_INF("Device settings reset");
}
```

## src/console.c
```c
#include "globals.h"
#include "system/system.h"
#include "system/battery_tracker.h"
#include "sensor/sensor.h"
#include "sensor/calibration.h"
#include "connection/esb.h"
#include "build_defines.h"
#include "parse_args.h"

#if CONFIG_USB_DEVICE_STACK
#define USB DT_NODELABEL(usbd)
#define USB_EXISTS (DT_NODE_HAS_STATUS(USB, okay) && CONFIG_UART_CONSOLE)
#endif

#if (USB_EXISTS || CONFIG_RTT_CONSOLE) && CONFIG_USE_SLIMENRF_CONSOLE

#if USB_EXISTS
#include <zephyr/console/console.h>
#include <zephyr/logging/log_ctrl.h>
#else
#include "system/rtt_console.h"
#endif
#include <zephyr/drivers/gpio.h>
#include <zephyr/sys/reboot.h>
#include <zephyr/sys/base64.h>

#include <ctype.h>

LOG_MODULE_REGISTER(console, LOG_LEVEL_INF);

static void console_thread(void);
#if USB_EXISTS
static struct k_thread console_thread_id;
static K_THREAD_STACK_DEFINE(console_thread_id_stack, 1024); // TODO: larger stack size to handle print info
#else
K_THREAD_DEFINE(console_thread_id, 1024, console_thread, NULL, NULL, NULL, CONSOLE_THREAD_PRIORITY, 0, 0);
#endif

#define DFU_EXISTS CONFIG_BUILD_OUTPUT_UF2 || CONFIG_BOARD_HAS_NRF5_BOOTLOADER
#define ADAFRUIT_BOOTLOADER CONFIG_BUILD_OUTPUT_UF2
#define NRF5_BOOTLOADER CONFIG_BOARD_HAS_NRF5_BOOTLOADER

#if NRF5_BOOTLOADER
static const struct device *gpio_dev = DEVICE_DT_GET(DT_NODELABEL(gpio0));
#endif

#if DT_NODE_HAS_STATUS(DT_NODELABEL(mag), okay)
#define SENSOR_MAG_EXISTS true
#endif

static const char *meows[] = {
	"Mew",
	"Meww",
	"Meow",
	"Meow meow",
	"Mrrrp",
	"Mrrf",
	"Mreow",
	"Mrrrow",
	"Mrrr",
	"Purr",
	"mew",
	"meww",
	"meow",
	"meow meow",
	"mrrrp",
	"mrrf",
	"mreow",
	"mrrrow",
	"mrrr",
	"purr",
};

static const char *meow_punctuations[] = {
	".",
	"?",
	"!",
	"-",
	"~",
	""
};

static const char *meow_suffixes[] = {
	" :3",
	" :3c",
	" ;3",
	" ;3c",
	" x3",
	" x3c",
	" X3",
	" X3c",
	" >:3",
	" >:3c",
	" >;3",
	" >;3c",
	""
};

static uint8_t meow_colors[] = {
	212,
	176,
	177
};

void console_thread_create(void)
{
#if USB_EXISTS
	k_thread_create(&console_thread_id, console_thread_id_stack, K_THREAD_STACK_SIZEOF(console_thread_id_stack), (k_thread_entry_t)console_thread, NULL, NULL, NULL, CONSOLE_THREAD_PRIORITY, 0, K_NO_WAIT);
#endif
}

void console_thread_abort(void)
{
#if USB_EXISTS
	k_thread_abort(&console_thread_id);
#endif
}

static void print_board(void)
{
#if USB_EXISTS
	printk(CONFIG_USB_DEVICE_MANUFACTURER " " CONFIG_USB_DEVICE_PRODUCT "\n");
#endif
	printk(FW_STRING);

	printk("\nBoard: " CONFIG_BOARD "\n");
	printk("SOC: " CONFIG_SOC "\n");
	printk("Target: " CONFIG_BOARD_TARGET "\n");
}

static void print_sensor(void)
{
	printk("IMU: %s\n", (retained->imu_addr & 0x7F) != 0x7F ? sensor_get_sensor_imu_name() : "Not searching");
	if (retained->imu_reg != 0xFF)
		printk("Interface: %s\n", (retained->imu_reg & 0x80) ? "SPI" : "I2C");
	printk("Address: 0x%02X%02X\n", retained->imu_addr, retained->imu_reg);

#if SENSOR_MAG_EXISTS
	printk("\nMagnetometer: %s\n", (retained->mag_addr & 0x7F) != 0x7F ? sensor_get_sensor_mag_name() : "Not searching");
	if (retained->mag_reg != 0xFF)
		printk("Interface: %s%s\n", (retained->mag_reg & 0x80) ? "SPI" : "I2C", (retained->mag_addr & 0x80) ? ", external" : "");
	printk("Address: 0x%02X%02X\n", retained->mag_addr, retained->mag_reg);
#endif

	if (CONFIG_1_SETTINGS_READ(CONFIG_1_SENSOR_USE_6_SIDE_CALIBRATION))
	{
		printk("\nAccelerometer matrix:\n");
		for (int i = 0; i < 3; i++)
			printk("%.5f %.5f %.5f %.5f\n", (double)retained->accBAinv[0][i], (double)retained->accBAinv[1][i], (double)retained->accBAinv[2][i], (double)retained->accBAinv[3][i]);
	}
	else
	{
		printk("\nAccelerometer bias: %.5f %.5f %.5f\n", (double)retained->accelBias[0], (double)retained->accelBias[1], (double)retained->accelBias[2]);
	}
	printk("Gyroscope bias: %.5f %.5f %.5f\n", (double)retained->gyroBias[0], (double)retained->gyroBias[1], (double)retained->gyroBias[2]);
#if SENSOR_MAG_EXISTS
//	printk("Magnetometer bridge offset: %.5f %.5f %.5f\n", (double)retained->magBias[0], (double)retained->magBias[1], (double)retained->magBias[2]);
	printk("Magnetometer matrix:\n");
	for (int i = 0; i < 3; i++)
		printk("%.5f %.5f %.5f %.5f\n", (double)retained->magBAinv[0][i], (double)retained->magBAinv[1][i], (double)retained->magBAinv[2][i], (double)retained->magBAinv[3][i]);
#endif

	printk("\nFusion: %s\n", sensor_get_sensor_fusion_name());
}

static void print_connection(void)
{
	bool paired = retained->paired_addr[0];
	printk(paired ? "Tracker ID: %u\n" : "Tracker ID: None\n", retained->paired_addr[1]);
	printk("Device address: %012llX\n", *(uint64_t *)NRF_FICR->DEVICEADDR & 0xFFFFFFFFFFFF);
	printk(paired ? "Receiver address: %012llX\n" : "Receiver address: None\n", (*(uint64_t *)&retained->paired_addr[0] >> 16) & 0xFFFFFFFFFFFF);
}

static void print_battery(void)
{
	int battery_mV = sys_get_valid_battery_mV();
	int16_t calibrated_pptt = sys_get_calibrated_battery_pptt(sys_get_valid_battery_pptt());
	uint64_t unplugged_time = sys_get_last_unplugged_time();
	uint64_t remaining = sys_get_battery_remaining_time_estimate();
	uint64_t runtime = sys_get_battery_runtime_estimate();
	if (battery_mV > 0)
	{
		unplugged_time = k_ticks_to_us_floor64(k_uptime_ticks() - unplugged_time);
		uint32_t hours = unplugged_time / 3600000000;
		unplugged_time %= 3600000000;
		uint8_t minutes = unplugged_time / 60000000;
		if (hours > 0 || minutes > 0)
			printk("Battery: %.0f%% (Read %uh %umin ago)\n", (double)calibrated_pptt / 100.0, hours, minutes);
		else
			printk("Battery: %.0f%%\n", (double)calibrated_pptt / 100.0);
	}
	else if (unplugged_time == 0)
	{
		printk("Battery: Waiting for valid reading\n");
	}
	else
	{
		printk("Battery: None\n");
	}
	if (remaining > 0)
	{
		remaining = k_ticks_to_us_floor64(remaining);
		uint32_t hours = remaining / 3600000000;
		remaining %= 3600000000;
		uint8_t minutes = remaining / 60000000;
		printk("Remaining runtime: %uh %umin\n", hours, minutes);
	}
	else
	{
		printk("Remaining runtime: Not available\n");
	}
	if (runtime > 0)
	{
		runtime = k_ticks_to_us_floor64(runtime);
		uint32_t hours = runtime / 3600000000;
		runtime %= 3600000000;
		uint8_t minutes = runtime / 60000000;
		printk("Fully charged runtime: %uh %umin\n", hours, minutes);
	}
	else
	{
		printk("Fully charged runtime: Not available\n");
	}
}

static void print_info(void)
{
	print_board();
	printk("\n");
	print_sensor();
	printk("\n");
	print_connection();
	printk("\n");
	print_battery();
}

static void print_uptime(const uint64_t ticks, const char *name)
{
	uint64_t uptime = k_ticks_to_us_floor64(ticks);

	uint32_t hours = uptime / 3600000000;
	uptime %= 3600000000;
	uint8_t minutes = uptime / 60000000;
	uptime %= 60000000;
	uint8_t seconds = uptime / 1000000;
	uptime %= 1000000;
	uint16_t milliseconds = uptime / 1000;
	uint16_t microseconds = uptime % 1000;

	printk("%s: %02u:%02u:%02u.%03u,%03u\n", name, hours, minutes, seconds, milliseconds, microseconds);
}

static void print_battery_tracker(void)
{
	int adc_mV = sys_get_battery_mV();
	printk("ADC: %d mV\n", adc_mV);

	int battery_mV = sys_get_valid_battery_mV();
	int16_t pptt = sys_get_valid_battery_pptt();
	int16_t calibrated_pptt = sys_get_calibrated_battery_pptt(pptt);
	uint64_t unplugged_time = sys_get_last_unplugged_time();
	if (battery_mV > 0)
		printk("\nBattery: %.2f%% (Raw %.2f%%, %d mV)\n", (double)calibrated_pptt / 100.0, (double)pptt / 100.0, battery_mV);
	else
		printk("\nBattery: None\n");
	if (unplugged_time > 0)
		print_uptime(k_uptime_ticks() - unplugged_time, "Last updated");
	else
		printk("Last updated: Never\n");

	uint64_t runtime = sys_get_battery_runtime_estimate();
	uint64_t runtime_min = sys_get_battery_runtime_min_estimate();
	uint64_t runtime_max = sys_get_battery_runtime_max_estimate();
	uint64_t remaining = sys_get_battery_remaining_time_estimate();
	if (remaining > 0)
		print_uptime(remaining, "\nRemaining runtime");
	else
		printk("Remaining runtime: Not available\n");
	if (runtime > 0)
		print_uptime(runtime, "Fully charged runtime");
	else
		printk("Fully charged runtime: Not available\n");
	if (runtime_min > 0)
		print_uptime(runtime_min, "Minimum runtime");
	else
		printk("Minimum runtime: Not available\n");
	if (runtime_max > 0)
		print_uptime(runtime_max, "Maximum runtime");
	else
		printk("Maximum runtime: Not available\n");

	int16_t last_min = sys_get_last_cycle_min_pptt();
	int16_t last_max = sys_get_last_cycle_max_pptt();
	int16_t last_calibrated_min = sys_get_calibrated_battery_pptt(last_min);
	int16_t last_calibrated_max = sys_get_calibrated_battery_pptt(last_max);
	uint64_t last_runtime = sys_get_last_cycle_runtime();
	if (last_min >= 0 && last_max >= 0 && last_runtime > 0)
	{
		printk("\nLast discharge cycle: %.2f%% -> %.2f%% (Raw %.2f%% -> %.2f%%)\n", (double)last_calibrated_max / 100.0, (double)last_calibrated_min / 100.0, (double)last_max / 100.0, (double)last_min / 100.0);
		print_uptime(last_runtime, "Last cycle runtime");
	}
	else
	{
		printk("\nLast cycle: Not available\n");
	}

	uint8_t coverage = sys_get_battery_calibration_coverage() * 5;
	int16_t min = sys_get_calibrated_battery_range_min_pptt();
	int16_t max = sys_get_calibrated_battery_range_max_pptt();
	if (min >= 0 && max >= 0)
		printk("\nCalibration: %.0f%% - %.0f%% (%.0f%% coverage)\n", (double)min / 100.0, (double)max / 100.0, (double)coverage);
	else
		printk("\nCalibration: None\n");
	printk("Cycle count: ~%.2f\n", (double)sys_get_battery_cycles() / 20.0);
}

static void print_meow(void)
{
	int64_t ticks = k_uptime_ticks();

	ticks %= ARRAY_SIZE(meows) * ARRAY_SIZE(meow_punctuations) * ARRAY_SIZE(meow_suffixes) * ARRAY_SIZE(meow_colors); // silly number generator
	uint8_t meow = ticks / (ARRAY_SIZE(meow_punctuations) * ARRAY_SIZE(meow_suffixes) * ARRAY_SIZE(meow_colors));
	ticks %= ARRAY_SIZE(meow_punctuations) * ARRAY_SIZE(meow_suffixes) * ARRAY_SIZE(meow_colors);
	uint8_t punctuation = ticks / (ARRAY_SIZE(meow_suffixes) * ARRAY_SIZE(meow_colors));
	ticks %= ARRAY_SIZE(meow_suffixes) * ARRAY_SIZE(meow_colors);
	uint8_t suffix = ticks / ARRAY_SIZE(meow_suffixes);
	uint8_t color = ticks % ARRAY_SIZE(meow_colors);

	printk("\033[38;5;%d;1m%s%s\033[0;38;2;255;255;255m%s\033[0m\n", meow_colors[color], meows[meow], meow_punctuations[punctuation], meow_suffixes[suffix]);
}

static int32_t parse_config_settings_id(char *s)
{
	int32_t id = parse_i32(s, 10);
	uint8_t buf[12];
	snprintk(buf, 12, "%d", id);
	if (strcmp(buf, s) != 0)
		return -1;
	return id;
}

static int parse_config_settings_write(char *s, int32_t v)
{
	int32_t id = parse_config_settings_id(s);
	uint16_t k = 0;
	int err = -1;
	for (int i = 0; i < CONFIG_SETTINGS_COUNT; i++)
	{
		for (int j = 0; j < config_settings_count[i]; j++)
		{
			if (id < 0 ? strcmp(s, config_settings_names[k]) == 0 : id == k)
			{
				switch (i)
				{
				case 0:
					if (v < 0 || v > 1)
						break;
					config_0_settings_write(j, v);
					err = 0;
					break;
				case 1:
					if (v < 0 || v > 1)
						break;
					config_1_settings_write(j, v);
					err = 0;
					break;
				case 2:
					if (v < INT16_MIN || v > INT16_MAX)
						break;
					config_2_settings_write(j, v);
					err = 0;
					break;
				case 3:
					config_3_settings_write(j, v);
					err = 0;
					break;
				default:
					break;
				}
				if (!err)
					printk("Updated config: %s=%d\n", config_settings_names[k], v);
				else
					printk("Invalid value\n");
				return err;
			}
			k++;
		}
	}
	printk("Invalid config name or id\n");
	return -1;
}

static void parse_config_settings_read(char *s)
{
	int32_t id = parse_config_settings_id(s);
	uint16_t k = 0;
	for (int i = 0; i < CONFIG_SETTINGS_COUNT; i++)
	{
		for (int j = 0; j < config_settings_count[i]; j++)
		{
			if (id < 0 ? strcmp(s, config_settings_names[k]) == 0 : id == k)
			{
				int32_t val = -1;
				switch (i)
				{
				case 0:
					val = CONFIG_0_SETTINGS_READ(j) ? 1 : 0;
					break;
				case 1:
					val = CONFIG_1_SETTINGS_READ(j) ? 1 : 0;
					break;
				case 2:
					val = CONFIG_2_SETTINGS_READ(j);
					break;
				case 3:
					val = CONFIG_3_SETTINGS_READ(j);
					break;
				default:
					break;
				}
				printk("Read config: %s=%d\n", config_settings_names[k], val);
				return;
			}
			k++;
		}
	}
	printk("Invalid config name or id\n");
}

static void parse_config_settings_read_all()
{
	uint16_t k = 0;
	for (int i = 0; i < CONFIG_SETTINGS_COUNT; i++)
	{
		for (int j = 0; j < config_settings_count[i]; j++)
		{
			int32_t val = -1;
			switch (i)
			{
			case 0:
				val = CONFIG_0_SETTINGS_READ(j) ? 1 : 0;
				break;
			case 1:
				val = CONFIG_1_SETTINGS_READ(j) ? 1 : 0;
				break;
			case 2:
				val = CONFIG_2_SETTINGS_READ(j);
				break;
			case 3:
				val = CONFIG_3_SETTINGS_READ(j);
				break;
			default:
				break;
			}
			printk("Read config: %s=%d\n", config_settings_names[k], val);
			k++;
		}
	}
}

static int parse_config_settings_reset(char *s)
{
	int32_t id = parse_config_settings_id(s);
	uint16_t k = 0;
	for (int i = 0; i < CONFIG_SETTINGS_COUNT; i++)
	{
		for (int j = 0; j < config_settings_count[i]; j++)
		{
			if (id < 0 ? strcmp(s, config_settings_names[k]) == 0 : id == k)
			{
				config_settings_reset(i, j);
				return 0;
			}
			k++;
		}
	}
	printk("Invalid config name or id\n");
	return -1;
}

static inline void strtolower(char *str)
{
	for (int i = 0; str[i]; i++)
		str[i] = tolower(str[i]);
}

static void print_help(void)
{
	printk("\nhelp                         Display this help text\n");

	printk("\ninfo                         Get device information\n");
	printk("uptime                       Get device uptime\n");
	printk("reboot                       Soft reset the device\n");
	printk("battery                      Get battery information\n");
	printk("\nscan                         Restart sensor scan\n");
	printk("calibrate                    Calibrate sensor ZRO\n");
	printk("6-side                       Calibrate 6-side accelerometer\n");
#if SENSOR_MAG_EXISTS
	printk("mag                          Clear magnetometer calibration\n");
#endif
	printk("\nset <address>                Manually set receiver\n");
	printk("pair                         Enter pairing mode\n");
	printk("clear                        Clear pairing data\n");
#if DFU_EXISTS
	printk("\ndfu                          Enter DFU bootloader\n");
#endif
	printk("\nmeow                         Meow!\n");

#if SENSOR_MAG_EXISTS
	printk("\nreset_data (zro|acc|mag|bat|all)\n");
#else
	printk("\nreset_data (zro|acc|bat|all)\n");
#endif

	printk("\nlist_config                  Display available settings\n");
	printk("write_config (base64|<config name>|<config id>) <value>\n");
	printk("read_config (all|base64|<config name>|<config id>)\n");
	printk("reset_config (all|<config name>|<config id>)\n");
}

static void console_thread(void)
{
#if USB_EXISTS && DFU_EXISTS
	if (button_read()) // button held on usb connect, enter DFU
	{
#if ADAFRUIT_BOOTLOADER
		NRF_POWER->GPREGRET = 0x57;
		sys_request_system_reboot(false);
#endif
#if NRF5_BOOTLOADER
		gpio_pin_configure(gpio_dev, 19, GPIO_OUTPUT | GPIO_OUTPUT_INIT_LOW);
#endif
	}
#endif

#if USB_EXISTS
	console_getline_init();
	while (log_data_pending())
		k_usleep(1);
	k_msleep(100);
	printk("*** " CONFIG_USB_DEVICE_MANUFACTURER " " CONFIG_USB_DEVICE_PRODUCT " ***\n");
#endif
	printk(FW_STRING);
	print_help();

	const char command_help[] = "help";

	const char command_info[] = "info";
	const char command_uptime[] = "uptime";
	const char command_reboot[] = "reboot";
	const char command_battery[] = "battery";
	const char command_scan[] = "scan";
	const char command_calibrate[] = "calibrate";
	const char command_6_side[] = "6-side";
#if SENSOR_MAG_EXISTS
	const char command_mag[] = "mag";
#endif
	const char command_set[] = "set";
	const char command_pair[] = "pair";
	const char command_clear[] = "clear";
#if DFU_EXISTS
	const char command_dfu[] = "dfu";
#endif
	const char command_meow[] = "meow";

	// data
	const char command_reset_data[] = "reset_data";
	const char command_reset_arg_zro[] = "zro";
	const char command_reset_arg_acc[] = "acc";
#if SENSOR_MAG_EXISTS
	const char command_reset_arg_mag[] = "mag";
#endif
	const char command_reset_arg_bat[] = "bat";
	const char command_reset_arg_all[] = "all";

	// settings
	const char command_list_config[] = "list_config";
	const char command_write_config[] = "write_config";
	const char command_read_config[] = "read_config";
	const char command_reset_config[] = "reset_config";
	const char command_wr_arg_all[] = "all";
	const char command_wr_arg_base64[] = "base64";

	// debug
	const char command_nvs[] = "nvs";

	while (1) {
#if USB_EXISTS
		char *line = console_getline();
#else
		char *line = rtt_console_getline();
#endif
		char* argv[5] = {NULL}; // command and 4 args
		size_t argc = parse_args(line, argv, ARRAY_SIZE(argv));
		if(argc == 0)
			continue;
		if(argc > 0)
			strtolower(argv[0]); // lower case the command
		if(argc > 1)
			strtolower(argv[1]); // lower case the first argument
		// only care that the first words are matchable

		if (strcmp(argv[0], command_help) == 0)
		{
			print_help();
		}
		else if (strcmp(argv[0], command_info) == 0)
		{
			print_info();
		}
		else if (strcmp(argv[0], command_uptime) == 0)
		{
			uint64_t uptime = k_uptime_ticks();
			print_uptime(uptime, "Uptime");
			print_uptime(uptime - retained->uptime_latest + retained->uptime_sum, "Accumulated");
		}
		else if (strcmp(argv[0], command_reboot) == 0)
		{
			sys_request_system_reboot(false);
		}
		else if (strcmp(argv[0], command_battery) == 0)
		{
			print_battery_tracker();
		}
		else if (strcmp(argv[0], command_scan) == 0)
		{
			sensor_request_scan(true);
		}
		else if (strcmp(argv[0], command_calibrate) == 0)
		{
			sensor_request_calibration();
		}
		else if (strcmp(argv[0], command_6_side) == 0)
		{
			sensor_request_calibration_6_side();
		}
#if SENSOR_MAG_EXISTS
		else if (strcmp(argv[0], command_mag) == 0)
		{
			sensor_calibration_clear_mag(NULL, true);
		}
#endif
		else if (strcmp(argv[0], "mag_recal") == 0)
		{
			// Reset RAM state but keep NVS — useful for tuning without
			// losing the persisted bias if the next attempt is worse.
			extern void rft_mag_cal_reset(void);
			rft_mag_cal_reset();
			printk("mag calibration RAM state reset — shake the tracker to recalibrate (NVS bias kept)\n");
		}
		else if (strcmp(argv[0], "mag_clear") == 0)
		{
			extern void rft_mag_clear_bias(void);
			rft_mag_clear_bias();
		}
		else if (strcmp(argv[0], "mag_off") == 0)
		{
			extern bool mag_enabled;
			mag_enabled = false;
			printk("mag fully disabled (no I2C reads, no VQF feed) — pure 6DoF\n");
		}
		else if (strcmp(argv[0], "mag_on") == 0)
		{
			extern bool mag_enabled;
			mag_enabled = true;
			printk("mag re-enabled\n");
		}
		else if (strcmp(argv[0], command_set) == 0)
		{
			if (argc != 2)
			{
				printk("Invalid number of arguments\n");
				continue;
			}
			uint64_t addr = parse_u64(argv[1], 16);
			uint8_t buf[17];
			snprintk(buf, 17, "%016llx", addr);
			if (addr != 0 && strcmp(buf, argv[1]) == 0)
				esb_set_pair(addr);
			else
				printk("Invalid address\n");
		}
		else if (strcmp(argv[0], command_pair) == 0)
		{
			esb_reset_pair();
		}
		else if (strcmp(argv[0], command_clear) == 0)
		{
			esb_clear_pair();
		}
#if DFU_EXISTS
		else if (strcmp(argv[0], command_dfu) == 0)
		{
#if ADAFRUIT_BOOTLOADER
			NRF_POWER->GPREGRET = 0x57;
			sys_request_system_reboot(false);
#endif
#if NRF5_BOOTLOADER
			gpio_pin_configure(gpio_dev, 19, GPIO_OUTPUT | GPIO_OUTPUT_INIT_LOW);
#endif
		}
#endif
		else if (strcmp(argv[0], command_meow) == 0)
		{
			print_meow();
		}
		else if (strcmp(argv[0], command_reset_data) == 0)
		{
			if (argc != 2)
				printk("Invalid number of arguments\n");
			else if (strcmp(argv[1], command_reset_arg_zro) == 0)
				sensor_calibration_clear(NULL, NULL, true);
			else if (strcmp(argv[1], command_reset_arg_acc) == 0)
				sensor_calibration_clear_6_side(NULL, true);
#if SENSOR_MAG_EXISTS
			else if (strcmp(argv[1], command_reset_arg_mag) == 0)
				sensor_calibration_clear_mag(NULL, true);
#endif
			else if (strcmp(argv[1], command_reset_arg_bat) == 0)
				sys_reset_battery_tracker();
			else if (strcmp(argv[1], command_reset_arg_all) == 0)
				sys_clear();
			else
				printk("Invalid argument\n");
		}
		else if (strcmp(line, command_list_config) == 0)
		{
			uint16_t k = 0;
			for (int i = 0; i < CONFIG_SETTINGS_COUNT; i++)
			{
				printk("Config %d:\n", i);
				for (int j = 0; j < config_settings_count[i]; j++)
				{
					printk("%u: %s\n", k, config_settings_names[k]);
					k++;
				}
			}
		}
		else if (strcmp(argv[0], command_write_config) == 0)
		{
			if (argc != 3)
			{
				printk("Invalid number of arguments\n");
			}
			else if (strcmp(argv[1], command_wr_arg_base64) == 0)
			{
				uint8_t *tmp = k_malloc(128);
				uint16_t len = 0;
				int err = base64_decode(tmp, 128, (size_t *)&len, argv[2], 172);
				if (err)
				{
					printk("Unable to decode input");
					continue;
				}
				//printk("decode: %d, len %d\n", err, len);
				memcpy(retained->settings, tmp, sizeof(retained->settings));
				config_settings_init(); // reset any non-overridden values
				sys_write(SETTINGS_ID, NULL, retained->settings, sizeof(retained->settings));
				k_free(tmp);
				printk("Updated config\n");
			}
			else
			{
				int32_t val = parse_i32(argv[2], 10);
				parse_config_settings_write(argv[1], val);
			}
		}
		else if (strcmp(line, command_read_config) == 0)
		{
			if (argc != 2)
			{
				printk("Invalid number of arguments\n");
			}
			else if (strcmp(argv[1], command_wr_arg_all) == 0)
			{
				parse_config_settings_read_all();
			}
			else if (strcmp(argv[1], command_wr_arg_base64) == 0)
			{
				uint8_t *tmp = k_malloc(173);
				uint16_t len = 0;
				base64_encode(tmp, 173, (size_t *)&len, retained->settings, 128);
				//printk("encode: %d, len %d\n", err, len);
				printk("%s\n", tmp);
				k_free(tmp);
			}
			else
			{
				parse_config_settings_read(argv[1]);
			}
		}
		else if (strcmp(line, command_reset_config) == 0)
		{
			if (argc != 2)
			{
				printk("Invalid number of arguments\n");
			}
			else if (strcmp(argv[1], command_wr_arg_all) == 0)
			{
				config_settings_reset_all();
			}
			else
			{
				if (!parse_config_settings_reset(argv[1]))
					printk("Reset config: %s\n", argv[1]);
			}
		}
		else if (strcmp(line, command_nvs) == 0)
		{
			sys_nvs_stats();
		}
		else
		{
			printk("Unknown command\n");
		}
	}
}

#endif
```

## src/globals.h
```c
/*
	SlimeVR Code is placed under the MIT license
	Copyright (c) 2025 SlimeVR Contributors

	Permission is hereby granted, free of charge, to any person obtaining a copy
	of this software and associated documentation files (the "Software"), to deal
	in the Software without restriction, including without limitation the rights
	to use, copy, modify, merge, publish, distribute, sublicense, and/or sell
	copies of the Software, and to permit persons to whom the Software is
	furnished to do so, subject to the following conditions:

	The above copyright notice and this permission notice shall be included in
	all copies or substantial portions of the Software.

	THE SOFTWARE IS PROVIDED "AS IS", WITHOUT WARRANTY OF ANY KIND, EXPRESS OR
	IMPLIED, INCLUDING BUT NOT LIMITED TO THE WARRANTIES OF MERCHANTABILITY,
	FITNESS FOR A PARTICULAR PURPOSE AND NONINFRINGEMENT. IN NO EVENT SHALL THE
	AUTHORS OR COPYRIGHT HOLDERS BE LIABLE FOR ANY CLAIM, DAMAGES OR OTHER
	LIABILITY, WHETHER IN AN ACTION OF CONTRACT, TORT OR OTHERWISE, ARISING FROM,
	OUT OF OR IN CONNECTION WITH THE SOFTWARE OR THE USE OR OTHER DEALINGS IN
	THE SOFTWARE.
*/
#ifndef SLIMENRF_GLOBALS
#define SLIMENRF_GLOBALS

#include <zephyr/logging/log.h>

#include "retained.h"
#include "config.h"
#include "thread_priority.h"

/* Sensor gyroscope, accelerometer, and magnetometer axes should align to the IMU body axes
 * SENSOR_QUATERNION_CORRECTION should align the sensor to the device following Android convention
 * On flat surface / face up:
 * Left from the perspective of the device / right from your perspective is +X
 * Front side (facing up) is +Z
 * Mounted on body / standing up:
 * Top side of the device is +Y
 * Front side (facing out) is +Z
 */

// TODO: not matching anymore
#if defined(CONFIG_BOARD_SLIMEVRMINI_P1_UF2) || defined(CONFIG_BOARD_SLIMEVRMINI_P2_UF2)
#define SENSOR_MAGNETOMETER_AXES_ALIGNMENT -mx, mz, -my
#define SENSOR_QUATERNION_CORRECTION 0.7071f, 0.7071f, 0.0f, 0.0f
#endif

#if defined(CONFIG_BOARD_SLIMENRF_R1) || defined(CONFIG_BOARD_SLIMENRF_R2) || defined(CONFIG_BOARD_SLIMENRF_R3)
#define SENSOR_QUATERNION_CORRECTION 0.0f, 0.7071f, 0.7071f, 0.0f
#endif

// RFT v1.1: IIS2MDC is mounted rotated relative to LSM6DSV (pin1 markers
// differ) AND the IIS2MDC chip's internal coordinate frame is left-handed
// (per ST community discussion of LIS2MDL — same mems family). The macro
// below maps mag-chip-local (mx,my,mz) into the IMU-body frame so that
// the resulting (m[0], m[1], m[2]) is right-handed in body coords.
//
// Confirmed empirically (2026-04-29) by sweeping all 8 LH/RH alignment
// variants on this PCB and watching `d` / `delta` stability — the LH
// rotation `-my, -mx, mz` was best. Mag is no longer fed into VQF (see
// vqf wrapper, magDeltaUpdateEnabled=false), so this only affects the
// diagnostic visualisation now; left in place so future re-enabling
// would just need a flag flip.
#if defined(CONFIG_BOARD_RFT_PCB_V1_1)
#define SENSOR_MAGNETOMETER_AXES_ALIGNMENT -my, -mx, mz
#endif

#ifndef SENSOR_MAGNETOMETER_AXES_ALIGNMENT
// mag axes alignment to sensor body
#define SENSOR_MAGNETOMETER_AXES_ALIGNMENT my, -mx, -mz
#endif
#ifndef SENSOR_QUATERNION_CORRECTION
// correction quat for sensor to mounting orientation
#define SENSOR_QUATERNION_CORRECTION 1.0f, 0.0f, 0.0f, 0.0f
#endif

#endif
```
